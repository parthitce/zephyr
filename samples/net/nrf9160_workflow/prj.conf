## CMakeLists.txt
```
#
# Copyright (c) 2018 Nordic Semiconductor
#
# SPDX-License-Identifier: LicenseRef-BSD-5-Clause-Nordic
#

cmake_minimum_required(VERSION 3.8.2)

include($ENV{ZEPHYR_BASE}/../nrf/cmake/boilerplate.cmake)
include($ENV{ZEPHYR_BASE}/cmake/app/boilerplate.cmake NO_POLICY_SCOPE)
project(nrf9160_workflow)

# NORDIC SDK APP START
target_sources(app PRIVATE src/main.c)
# NORDIC SDK APP END
```

## prj.conf
```kconfig
#
# Copyright (c) 2019 Nordic Semiconductor ASA
#
# SPDX-License-Identifier: LicenseRef-BSD-5-Clause-Nordic
#

# Networking
CONFIG_NETWORKING=y
CONFIG_NET_NATIVE=n
CONFIG_NET_SOCKETS_OFFLOAD=y
CONFIG_NET_SOCKETS=y
CONFIG_NET_SOCKETS_POSIX_NAMES=y

# LTE link control
CONFIG_LTE_LINK_CONTROL=y
CONFIG_LTE_AUTO_INIT_AND_CONNECT=n

# BSD library
CONFIG_BSD_LIBRARY=y

# AT Host
CONFIG_UART_INTERRUPT_DRIVEN=y
CONFIG_AT_HOST_LIBRARY=y

# MQTT
CONFIG_MQTT_LIB=y
CONFIG_MQTT_LIB_TLS=n

# Appliaction
CONFIG_MQTT_PUB_TOPIC="test_channel"
CONFIG_MQTT_SUB_TOPIC="test_channel"
CONFIG_MQTT_CLIENT_ID=""
CONFIG_MQTT_BROKER_HOSTNAME="117.221.133.237"
CONFIG_MQTT_BROKER_PORT=1883

# Main thread
CONFIG_MAIN_STACK_SIZE=4096
CONFIG_HEAP_MEM_POOL_SIZE=2048

# Enable accelerometer
CONFIG_LIS2DH=y
CONFIG_LIS2DH_ACCEL_RANGE_4G=y
CONFIG_LIS2DH_PULSE=y
CONFIG_LIS2DH_OPER_MODE_LOW_POWER=y
CONFIG_LIS2DH_TRIGGER_OWN_THREAD=y
# Operating frequency 50Hz. During wakeup sensor trigger data ready interrupt @50Hz.
# When sleep detected sensor trigger data ready interrupt @10Hz. 
CONFIG_LIS2DH_ODR_4=y


# Select NB-IoT
CONFIG_LTE_NETWORK_MODE_NBIOT=y

# Enable Temperature sensor HTS221
CONFIG_I2C=y
CONFIG_SENSOR=y
CONFIG_HTS221=y
CONFIG_HTS221_TRIGGER_NONE=y

# Enable GPIO Port
CONFIG_GPIO=y
```

## src/main.c
```c
/*
 * Copyright (c) 2020 Linumiz
 *
 * SPDX-License-Identifier: LicenseRef-BSD-5-Clause-Nordic
 */

#include <zephyr.h>
#include <stdio.h>
#include <drivers/uart.h>
#include <string.h>

#include <net/mqtt.h>
#include <net/socket.h>
#include <modem/lte_lc.h>
#if defined(CONFIG_LWM2M_CARRIER)
#include <lwm2m_carrier.h>
#endif

#include <drivers/sensor.h>
#include <sys/util.h>
#define temp_limit 30 /* Temperature limit in C */
#define hts221_sleep_ms 1000
float current_temp;

#define MQTT_STACKSIZE 8192
#define MQTT_PRIORITY 7

#include <drivers/gpio.h>
/* LED macro */
#define GREEN_LED_PORT    DT_ALIAS_LED1_GPIOS_CONTROLLER
#define BLUE_LED_PORT     DT_ALIAS_LED2_GPIOS_CONTROLLER

#define GREEN_LED   DT_ALIAS_LED1_GPIOS_PIN
#define BLUE_LED    DT_ALIAS_LED2_GPIOS_PIN

#define LED_BLINK_STACKSIZE 2048
#define LED_BLINK_PRIORITY  99 


/* Buffers for MQTT client. */
static u8_t rx_buffer[CONFIG_MQTT_MESSAGE_BUFFER_SIZE];
static u8_t tx_buffer[CONFIG_MQTT_MESSAGE_BUFFER_SIZE];
static u8_t payload_buf[CONFIG_MQTT_PAYLOAD_BUFFER_SIZE];

/* The mqtt client struct */
static struct mqtt_client client;

/* MQTT Broker details. */
static struct sockaddr_storage broker;

/* Connected flag */
static bool connected;

/* File descriptor */
static struct pollfd fds;

#if defined(CONFIG_BSD_LIBRARY)

/**@brief Recoverable BSD library error. */
void bsd_recoverable_error_handler(uint32_t err)
{
	printk("bsdlib recoverable error: %u\n", (unsigned int)err);
}

#endif /* defined(CONFIG_BSD_LIBRARY) */

#if defined(CONFIG_LWM2M_CARRIER)
K_SEM_DEFINE(carrier_registered, 0, 1);

void lwm2m_carrier_event_handler(const lwm2m_carrier_event_t *event)
{
	switch (event->type) {
	case LWM2M_CARRIER_EVENT_BSDLIB_INIT:
		printk("LWM2M_CARRIER_EVENT_BSDLIB_INIT\n");
		break;
	case LWM2M_CARRIER_EVENT_CONNECT:
		printk("LWM2M_CARRIER_EVENT_CONNECT\n");
		break;
	case LWM2M_CARRIER_EVENT_DISCONNECT:
		printk("LWM2M_CARRIER_EVENT_DISCONNECT\n");
		break;
	case LWM2M_CARRIER_EVENT_READY:
		printk("LWM2M_CARRIER_EVENT_READY\n");
		k_sem_give(&carrier_registered);
		break;
	case LWM2M_CARRIER_EVENT_FOTA_START:
		printk("LWM2M_CARRIER_EVENT_FOTA_START\n");
		break;
	case LWM2M_CARRIER_EVENT_REBOOT:
		printk("LWM2M_CARRIER_EVENT_REBOOT\n");
		break;
	}
}
#endif /* defined(CONFIG_LWM2M_CARRIER) */

/**@brief Function to print strings without null-termination
 */
static void data_print(u8_t *prefix, u8_t *data, size_t len)
{
	char buf[len + 1];

	memcpy(buf, data, len);
	buf[len] = 0;
	printk("%s%s\n", prefix, buf);
}

/**@brief Function to publish data on the configured topic
 */
static int data_publish(struct mqtt_client *c, enum mqtt_qos qos,
	u8_t *data, size_t len)
{
	struct mqtt_publish_param param;

	param.message.topic.qos = qos;
	param.message.topic.topic.utf8 = CONFIG_MQTT_PUB_TOPIC;
	param.message.topic.topic.size = strlen(CONFIG_MQTT_PUB_TOPIC);
	param.message.payload.data = data;
	param.message.payload.len = len;
	param.message_id = sys_rand32_get();
	param.dup_flag = 0;
	param.retain_flag = 0;

	data_print("Publishing: ", data, len);
	printk("to topic: %s len: %u\n",
		CONFIG_MQTT_PUB_TOPIC,
		(unsigned int)strlen(CONFIG_MQTT_PUB_TOPIC));

	return mqtt_publish(c, &param);
}

/**@brief Function to subscribe to the configured topic
 */
static int subscribe(void)
{
	struct mqtt_topic subscribe_topic = {
		.topic = {
			.utf8 = CONFIG_MQTT_SUB_TOPIC,
			.size = strlen(CONFIG_MQTT_SUB_TOPIC)
		},
		.qos = MQTT_QOS_1_AT_LEAST_ONCE
	};

	const struct mqtt_subscription_list subscription_list = {
		.list = &subscribe_topic,
		.list_count = 1,
		.message_id = 1234
	};

	printk("Subscribing to: %s len %u\n", CONFIG_MQTT_SUB_TOPIC,
		(unsigned int)strlen(CONFIG_MQTT_SUB_TOPIC));

	return mqtt_subscribe(&client, &subscription_list);
}

/**@brief Function to read the published payload.
 */
static int publish_get_payload(struct mqtt_client *c, size_t length)
{
	u8_t *buf = payload_buf;
	u8_t *end = buf + length;

	if (length > sizeof(payload_buf)) {
		return -EMSGSIZE;
	}

	while (buf < end) {
		int ret = mqtt_read_publish_payload(c, buf, end - buf);

		if (ret < 0) {
			int err;

			if (ret != -EAGAIN) {
				return ret;
			}

			printk("mqtt_read_publish_payload: EAGAIN\n");

			err = poll(&fds, 1, K_SECONDS(CONFIG_MQTT_KEEPALIVE));
			if (err > 0 && (fds.revents & POLLIN) == POLLIN) {
				continue;
			} else {
				return -EIO;
			}
		}

		if (ret == 0) {
			return -EIO;
		}

		buf += ret;
	}

	return 0;
}

/**@brief MQTT client event handler
 */
void mqtt_evt_handler(struct mqtt_client *const c,
		      const struct mqtt_evt *evt)
{
	int err;

	switch (evt->type) {
	case MQTT_EVT_CONNACK:
		if (evt->result != 0) {
			printk("MQTT connect failed %d\n", evt->result);
			break;
		}

		connected = true;
		printk("[%s:%d] MQTT client connected!\n", __func__, __LINE__);
		subscribe();
		break;

	case MQTT_EVT_DISCONNECT:
		printk("[%s:%d] MQTT client disconnected %d\n", __func__,
		       __LINE__, evt->result);

		connected = false;
		break;

	case MQTT_EVT_PUBLISH: {
		const struct mqtt_publish_param *p = &evt->param.publish;

		printk("[%s:%d] MQTT PUBLISH result=%d len=%d\n", __func__,
		       __LINE__, evt->result, p->message.payload.len);
		err = publish_get_payload(c, p->message.payload.len);
		if (err >= 0) {
			data_print("Received: ", payload_buf,
				p->message.payload.len);
			/* Echo back received data */
			data_publish(&client, MQTT_QOS_1_AT_LEAST_ONCE,
				payload_buf, p->message.payload.len);
		} else {
			printk("mqtt_read_publish_payload: Failed! %d\n", err);
			printk("Disconnecting MQTT client...\n");

			err = mqtt_disconnect(c);
			if (err) {
				printk("Could not disconnect: %d\n", err);
			}
		}
	} break;

	case MQTT_EVT_PUBACK:
		if (evt->result != 0) {
			printk("MQTT PUBACK error %d\n", evt->result);
			break;
		}

		printk("[%s:%d] PUBACK packet id: %u\n", __func__, __LINE__,
				evt->param.puback.message_id);
		break;

	case MQTT_EVT_SUBACK:
		if (evt->result != 0) {
			printk("MQTT SUBACK error %d\n", evt->result);
			break;
		}

		printk("[%s:%d] SUBACK packet id: %u\n", __func__, __LINE__,
				evt->param.suback.message_id);
		break;

	default:
		printk("[%s:%d] default: %d\n", __func__, __LINE__,
				evt->type);
		break;
	}
}

/**@brief Resolves the configured hostname and
 * initializes the MQTT broker structure
 */
static void broker_init(void)
{
	int err;
	struct addrinfo *result;
	struct addrinfo *addr;
	struct addrinfo hints = {
		.ai_family = AF_INET,
		.ai_socktype = SOCK_STREAM
	};

	err = getaddrinfo(CONFIG_MQTT_BROKER_HOSTNAME, NULL, &hints, &result);
	if (err) {
		printk("ERROR: getaddrinfo failed %d\n", err);

		return;
	}

	addr = result;
	err = -ENOENT;

	/* Look for address of the broker. */
	while (addr != NULL) {
		/* IPv4 Address. */
		if (addr->ai_addrlen == sizeof(struct sockaddr_in)) {
			struct sockaddr_in *broker4 =
				((struct sockaddr_in *)&broker);
			char ipv4_addr[NET_IPV4_ADDR_LEN];

			broker4->sin_addr.s_addr =
				((struct sockaddr_in *)addr->ai_addr)
				->sin_addr.s_addr;
			broker4->sin_family = AF_INET;
			broker4->sin_port = htons(CONFIG_MQTT_BROKER_PORT);

			inet_ntop(AF_INET, &broker4->sin_addr.s_addr,
				  ipv4_addr, sizeof(ipv4_addr));
			printk("IPv4 Address found %s\n", ipv4_addr);

			break;
		} else {
			printk("ai_addrlen = %u should be %u or %u\n",
				(unsigned int)addr->ai_addrlen,
				(unsigned int)sizeof(struct sockaddr_in),
				(unsigned int)sizeof(struct sockaddr_in6));
		}

		addr = addr->ai_next;
		break;
	}

	/* Free the address. */
	freeaddrinfo(result);
}

/**@brief Initialize the MQTT client structure
 */
static void client_init(struct mqtt_client *client)
{
	mqtt_client_init(client);

	broker_init();

	/* MQTT client configuration */
	client->broker = &broker;
	client->evt_cb = mqtt_evt_handler;
	client->client_id.utf8 = (u8_t *)CONFIG_MQTT_CLIENT_ID;
	client->client_id.size = strlen(CONFIG_MQTT_CLIENT_ID);
	client->password = NULL;
	client->user_name = NULL;
	client->protocol_version = MQTT_VERSION_3_1_1;

	/* MQTT buffers configuration */
	client->rx_buf = rx_buffer;
	client->rx_buf_size = sizeof(rx_buffer);
	client->tx_buf = tx_buffer;
	client->tx_buf_size = sizeof(tx_buffer);

	/* MQTT transport configuration */
	client->transport.type = MQTT_TRANSPORT_NON_SECURE;
}

/**@brief Initialize the file descriptor structure used by poll.
 */
static int fds_init(struct mqtt_client *c)
{
	if (c->transport.type == MQTT_TRANSPORT_NON_SECURE) {
		fds.fd = c->transport.tcp.sock;
	} else {
#if defined(CONFIG_MQTT_LIB_TLS)
		fds.fd = c->transport.tls.sock;
#else
		return -ENOTSUP;
#endif
	}

	fds.events = POLLIN;

	return 0;
}

/**@brief Configures modem to provide LTE link. Blocks until link is
 * successfully established.
 */
static void modem_configure(void)
{
#if defined(CONFIG_LTE_LINK_CONTROL)
	if (IS_ENABLED(CONFIG_LTE_AUTO_INIT_AND_CONNECT)) {
		/* Do nothing, modem is already turned on
		 * and connected.
		 */
	} else {
#if defined(CONFIG_LWM2M_CARRIER)
		/* Wait for the LWM2M_CARRIER to configure the modem and
		 * start the connection.
		 */
		printk("Waitng for carrier registration...\n");
		k_sem_take(&carrier_registered, K_FOREVER);
		printk("Registered!\n");
#else /* defined(CONFIG_LWM2M_CARRIER) */
		int err;

		printk("LTE Link Connecting ...\n");
		err = lte_lc_init_and_connect();
		__ASSERT(err == 0, "LTE link could not be established.");
		printk("LTE Link Connected!\n");
#endif /* defined(CONFIG_LWM2M_CARRIER) */
	}
#endif /* defined(CONFIG_LTE_LINK_CONTROL) */
}

static void shutdown_modem(void)
{
        /* Turn off and shutdown modem */
        int err = lte_lc_power_off();

        if (err) {
                printk("lte_lc_power_off failed: %d", err);
        }
	printk("LTE link disconnected \n");
}

static void process_sample_hts221(struct device *dev) 
{
	struct sensor_value temp;
	if (sensor_sample_fetch(dev) < 0) {
		printk("HTS221 sample update error \n");
		return;
	}

	if (sensor_channel_get(dev, SENSOR_CHAN_AMBIENT_TEMP, &temp) < 0) {
		printk("Cannot read HTS221 temperature channel\n");
		return;
	}

	current_temp = sensor_value_to_double(&temp);
	printf("Temperature:%.1f C\n", current_temp);
}

#define LIS2DH_ACTIVE_MODE     1
#define LIS2DH_SLEEP_MODE      0

static u32_t time, prev_time, t;
/* lis2dh_mode = 1 Wakeup detected 
 * lis2dh_mode = 0 sleep detected */
static bool lis2dh_mode;

static void sleep_modeCallback(void)
{
        printk("print from sleep mode callback \n");
	printk("mode: %d \n", lis2dh_mode);
}

static void active_modeCallback(void)
{
        printk("print from active mode callback \n");
	printk("mode: %d \n", lis2dh_mode);
}

static void mode_changed(void (*ptr)())
{
        (*ptr)();
}
void (*ptr1)() = &sleep_modeCallback;
void (*ptr2)() = &active_modeCallback;

static void process_lis2dh(struct device *sensor)
{
        int rc = sensor_sample_fetch(sensor);
        if (rc < 0) {
                printf("Unabe to fetch sample: %d \n", rc);
        }

        time = k_uptime_get_32();
        t = time - prev_time;

        //printf("t: %d \n", t);

        prev_time = time;

        if ((t < 80) && (lis2dh_mode == LIS2DH_SLEEP_MODE)) {
                lis2dh_mode = LIS2DH_ACTIVE_MODE;
                mode_changed(active_modeCallback);
        } else if ((t > 80) && (lis2dh_mode == LIS2DH_ACTIVE_MODE)) {
                lis2dh_mode = LIS2DH_SLEEP_MODE;
                mode_changed(sleep_modeCallback);
        }
}

#ifdef CONFIG_LIS2DH_TRIGGER
static void trigger_handler(struct device *dev,
                            struct sensor_trigger *trig)
{
        process_lis2dh(dev);
}
#endif

static bool lte_mqtt_status = 0;

static void mqtt_thread(void)
{
	int err;
	enum lte_lc_func_mode functional_mode;

	while(1) {	
		if ((current_temp > temp_limit) || (lis2dh_mode == 1)) {
       			
		       	
			/*LTE and mqtt connected */
			err = lte_lc_func_mode_get(&functional_mode);
        		if (err) {
                		printk("could not get modem's functional mode, erro: %d \n", err);
                		return;
        		} 
			
			/* funtional_mode = 0 modem is powered off */
			if (functional_mode == 0) {
				modem_configure(); /* configure and init modem */
			}

			client_init(&client);

			err = mqtt_connect(&client);
			if (err != 0) {
				printk("ERROR: mqtt_connect %d\n", err);
				return;
			}
			
			lte_mqtt_status = 1;

			err = fds_init(&client);
			if (err != 0) {
				printk("ERROR: fds_init %d\n", err);
				return;
			}
			
			
			
			while (1) {
				err = poll(&fds, 1, mqtt_keepalive_time_left(&client));
				if (err < 0) {
					printk("ERROR: poll %d\n", errno);
					break;
				}

				err = mqtt_live(&client);
				if ((err != 0) && (err != -EAGAIN)) {
					printk("ERROR: mqtt_live %d\n", err);
					break;
				}

				if ((fds.revents & POLLIN) == POLLIN) {
					err = mqtt_input(&client);
					if (err != 0) {
						printk("ERROR: mqtt_input %d\n", err);
						break;
					}
				}	

				if ((fds.revents & POLLERR) == POLLERR) {
					printk("POLLERR\n");
					break;
				}

				if ((fds.revents & POLLNVAL) == POLLNVAL) {
					printk("POLLNVAL\n");
					break;
				}

				if ((current_temp < temp_limit) && (lis2dh_mode == 0)) {
					printk("Temperature decreased and sleep mode detected \n");
					break;
				}
			}

			printk("Disconnecting MQTT client...\n");

			err = mqtt_disconnect(&client);
			if (err) {
				printk("Could not disconnect MQTT client. Error: %d\n", err);
			}
        	} else {
			lte_mqtt_status = 0; /* LTE and mqtt disconnected */	
			err = lte_lc_func_mode_get(&functional_mode);
                        if (err) {
                                printk("could not get modem's functional mode, erro: %d \n", err);
                                return;
                        }
			
			if (functional_mode != 0) {
				shutdown_modem();
                		printk("Sleep mode \n");
			}
        	}
	}
}

static void led_blink_thread(void) 
{
	struct device *green_led_dev, *blue_led_dev;

	green_led_dev = device_get_binding(GREEN_LED_PORT);
	if (green_led_dev == NULL) {
		printk("Could not get GREEN LED device\n");
		return;
	}

	blue_led_dev = device_get_binding(BLUE_LED_PORT);
	if (blue_led_dev == NULL) {
		printk("Could not get BLUE LED device\n");
		return;
	}

	/* Set LED pin as output */
	gpio_pin_configure(green_led_dev, GREEN_LED, GPIO_DIR_OUT);
	gpio_pin_configure(blue_led_dev, BLUE_LED, GPIO_DIR_OUT);
	
	while (1) {
		if (lte_mqtt_status == 1) {
			gpio_pin_write(green_led_dev, GREEN_LED, 1);
			gpio_pin_write(blue_led_dev, BLUE_LED, 0);
			printk("LTE and mqtt connected \n");
			k_sleep(1000);
		} else if (lte_mqtt_status == 0) {
			gpio_pin_write(green_led_dev, GREEN_LED, 0);
                	gpio_pin_write(blue_led_dev, BLUE_LED, 1);
			printk("LTE and mqtt disconnected \n");
			k_sleep(1000);
		}
	}
}



void main(void)
{
	struct device *hts221_dev = device_get_binding("HTS221");
	
	if (hts221_dev == NULL) {
		printk("Could not get HTS221 device \n");
		return;
	}

	struct device *lis2dh_dev = device_get_binding(DT_INST_0_ST_LIS2DH_LABEL);
	if (lis2dh_dev == NULL) {
		printk("Could not get LIS2DH device \n");
		return;
	}

#if CONFIG_LIS2DH_TRIGGER
	{
		struct sensor_trigger trig;
		int rc;

		trig.type = SENSOR_TRIG_DATA_READY;
		trig.chan = SENSOR_CHAN_ACCEL_XYZ;

		rc = sensor_trigger_set(lis2dh_dev, &trig, trigger_handler);

		if (rc != 0) {
			printf("Failed to set trigger: %d\n", rc);
			return;
		}

                static struct sensor_value activity_threshold;

                activity_threshold.val1 = 5; /* wake/sleep threshold */
                activity_threshold.val2 = 226600;
                rc = sensor_attr_set(lis2dh_dev, SENSOR_CHAN_ACTIVITY, SENSOR_ATTR_ACTIVITY_TH, &activity_threshold);
                if (rc) {
                        printk("Unable to set Activity Threshold\n");
                }

                static struct sensor_value activity_duration;

                activity_duration.val1 = 5;  /* Set wake/sleep time in seconds from 0 sec to 127 sec */
                activity_duration.val2 = 0;

                rc = sensor_attr_set(lis2dh_dev, SENSOR_CHAN_ACTIVITY, SENSOR_ATTR_ACTIVITY_DUR, &activity_duration);
                if (rc) {
                        printk("Unable to set Activity duration \n");
                }
	}
#else

#endif
	printk("nrf9160 workflow sample started\n");
	
	while (1) {
		process_sample_hts221(hts221_dev);
		k_sleep(hts221_sleep_ms);
	}
}

/* Thread for LED blinking to indicate LTE connection state */
K_THREAD_DEFINE(led_blink_id, LED_BLINK_STACKSIZE, led_blink_thread, NULL, NULL,
		NULL, LED_BLINK_PRIORITY, 0, K_NO_WAIT);

/* Thread to init LTE and mqtt client based on the lis2dh sleep/wake and temperature limit  */
K_THREAD_DEFINE(mqtt_thread_id, MQTT_STACKSIZE, mqtt_thread, NULL, NULL, NULL,
                MQTT_PRIORITY, 0, K_NO_WAIT);
```
