## CMakeLists.txt
```
# Copyright (c) 2020 Linumiz
#
# SPDX-License-Identifier: Apache-2.0

cmake_minimum_required(VERSION 3.13.1)

# This application has its own Kconfig options.
set(KCONFIG_ROOT ${CMAKE_CURRENT_SOURCE_DIR}/Kconfig)

include($ENV{ZEPHYR_BASE}/cmake/app/boilerplate.cmake NO_POLICY_SCOPE)
project(hawkbit)

target_include_directories(app PRIVATE $ENV{ZEPHYR_BASE}/lib/hawkbit/include)
FILE(GLOB app_sources src/*.c)
target_sources(app PRIVATE ${app_sources})
target_sources_ifdef(CONFIG_NET_DHCPV4 app PRIVATE src/dhcp.c)

include($ENV{ZEPHYR_BASE}/samples/net/common/common.cmake)

set(gen_dir ${ZEPHYR_BINARY_DIR}/include/generated/)

generate_inc_file_for_target(
    app
    src/globalsign_r2.der
    ${gen_dir}/globalsign_r2.der.inc
    )
```

## Kconfig
```
# Copyright (c) 2020 Linumiz
# SPDX-License-Identifier: Apache-2.0

mainmenu "Sample app Configuration"

config HAWKBIT_MANUAL
	bool "Hawkbit manual mode"
	help
	  Manual mode requires the user to call the server probe and then, if 
	  there is an available update, also requires the user to decide if 
	  it is appropriate to update now or later.

if !HAWKBIT_MANUAL
config HAWKBIT_POLLING
	bool "Hawkbit polling mode"
	default y
	help 
	  Polling mode runs automatically on a predefined period, probing the
	  server for updates and installing them without requiring user
	  intervention.
endif #!HAWKBIT_MANUAL 

source "Kconfig.zephyr"
```

## prj.conf
```kconfig
#Turn on the Hawkbit
CONFIG_HAWKBIT=y

#Minimal Heap mem pool size for the Hawkbit working
CONFIG_HEAP_MEM_POOL_SIZE=4096
CONFIG_SYSTEM_WORKQUEUE_STACK_SIZE=4096

CONFIG_NET_IPV4=y
CONFIG_NET_IPV6=n

#Enable DHCPv4 server
CONFIG_NET_DHCPV4=y
CONFIG_NET_MGMT=y
CONFIG_NET_MGMT_EVENT=y

#Enable DNS Resolver
CONFIG_DNS_RESOLVER=y
CONFIG_DNS_SERVER_IP_ADDRESSES=y
CONFIG_DNS_SERVER1="8.8.8.8"
CONFIG_DNS_SERVER2="192.168.1.1"

#Optional if you would like test on the your server
CONFIG_SHELL=y
CONFIG_HAWKBIT_SHELL=y

#Debug helpers
CONFIG_LOG=y
CONFIG_HAWKBIT_LOG_LEVEL_INF=n

#Hawkbit server poll interval in seconds
CONFIG_HAWKBIT_POLL_INTERVAL=60

#General Config 
CONFIG_NEWLIB_LIBC=y
CONFIG_LOG_BUFFER_SIZE=4096

#Bootloader Config
CONFIG_BOOTLOADER_MCUBOOT=y

#Generate HEX output 
CONFIG_BUILD_OUTPUT_HEX=y

#LOG Maximum string define
CONFIG_LOG_STRDUP_MAX_STRING=100
CONFIG_LOG_STRDUP_BUF_COUNT=20
```

## overlay-tls.conf
```kconfig
CONFIG_MAIN_STACK_SIZE=4096

# TLS configuration
CONFIG_MBEDTLS=y
CONFIG_MBEDTLS_BUILTIN=y
CONFIG_MBEDTLS_ENABLE_HEAP=y
CONFIG_MBEDTLS_HEAP_SIZE=30000
CONFIG_MBEDTLS_SSL_MAX_CONTENT_LEN=4096

CONFIG_NET_SOCKETS_SOCKOPT_TLS=y
#CONFIG_MBEDTLS_KEY_EXCHANGE_ALL_ENABLED=y
#CONFIG_MBEDTLS_CIPHER_ALL_ENABLED=y
#CONFIG_MBEDTLS_ECP_ALL_ENABLED=y
#CONFIG_MBEDTLS_MAC_ALL_ENABLED=y
#CONFIG_MBEDTLS_GENPRIME_ENABLED=y
#CONFIG_MBEDTLS_HMAC_DRBG_ENABLED=y
```

## src/main.c
```c
/*
 * Copyright (c) 2020 Linumiz
 *
 * SPDX-License-Identifier: Apache-2.0
 */

#include <zephyr.h>
#include <hawkbit.h>
#include <dfu/mcuboot.h>
#include <sys/printk.h>
#include <logging/log.h>

#include "dhcp.h"

#if defined(CONFIG_NET_SOCKETS_SOCKOPT_TLS)
#include <net/tls_credentials.h>
#include "ca_certificate.h"
#endif

LOG_MODULE_REGISTER(main);

void main(void) 
{
	int ret = -1;
	LOG_INF("Hawkbit sample app started");

	app_dhcpv4_startup();

#if defined(CONFIG_NET_SOCKETS_SOCKOPT_TLS)
        tls_credential_add(CA_CERTIFICATE_TAG, TLS_CREDENTIAL_CA_CERTIFICATE,
                           ca_certificate, sizeof(ca_certificate));
#endif

	ret = hawkbit_init();

	if (ret < 0) {
		LOG_ERR("Failed to init hawkbit");
	}

#if defined(CONFIG_HAWKBIT_POLLING)
	LOG_INF("Starting hawkbit polling mode");
	hawkbit_autohandler();
#endif

#if defined(CONFIG_HAWKBIT_MANUAL)
	LOG_INF("Starting Hawkbit manual mode");

	enum hawkbit_response resp;

	switch(hawkbit_probe()) {
        case HAWKBIT_UNCONFIRMED_IMAGE:
                LOG_ERR("Image in unconfirmed. Rebooting to revert back to previous"
                        "confirmed image.");

                sys_reboot(SYS_REBOOT_WARM);
                break;

        case HAWKBIT_NO_UPDATE:
                LOG_INF("No update found");
                break;

        case HAWKBIT_CANCEL_UPDATE:
                LOG_INF("Hawkbit update Cancelled from server");
                break;

        case HAWKBIT_OK:
                LOG_INF("Image is already updated");
                break;

        case HAWKBIT_UPDATE_INSTALLED:
                LOG_INF("");
                break;

        default:
                break;
        }

#endif

}
```

## src/dhcp.c
```c
/*
 * Copyright (c) 2020 Linumiz
 *
 * SPDX-License-Identifier: Apache-2.0
 */

#include <logging/log.h>

#include <zephyr.h>

#include <net/net_if.h>
#include <net/net_core.h>
#include <net/net_context.h>
#include <net/net_mgmt.h>

static struct net_mgmt_event_callback mgmt_cb;

/* Semaphore to indicate a lease has been acquired */
static K_SEM_DEFINE(got_address, 0, 1);

static void handler(struct net_mgmt_event_callback *cb,
			   u32_t mgmt_event,
			   struct net_if *iface)
{
	int i = 0;
	bool notified = false;

	if (mgmt_event != NET_EVENT_IPV4_ADDR_ADD) {
		return;
	}

	for (i = 0; i < NET_IF_MAX_IPV4_ADDR; i++) {
		
		if (iface->config.ip.ipv4->unicast[i].addr_type != 
		    NET_ADDR_DHCP) {
			continue;
		}

		if (!notified) {
			k_sem_give(&got_address);
			notified = true;
		}	
		break;
	}
}

/**
 * Start a DHCP client, and wait for a lease to be acquired.
 */
void app_dhcpv4_startup(void)
{
	struct net_if *iface;

//	LOG_INF("starting DHCPV4");

	net_mgmt_init_event_callback(&mgmt_cb, handler, 
				     NET_EVENT_IPV4_ADDR_ADD);	
	net_mgmt_add_event_callback(&mgmt_cb);

	iface = net_if_get_default();

	net_dhcpv4_start(iface);

	/* Wait for a lease */
	k_sem_take(&got_address, K_FOREVER);
}
```
